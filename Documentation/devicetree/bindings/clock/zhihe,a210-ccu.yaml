## Documentation/devicetree/bindings/phy/zhihe,a210-c10phy.yaml
```yaml
# SPDX-License-Identifier: (GPL-2.0-only OR BSD-2-Clause)
%YAML 1.2
---
$id: http://devicetree.org/schemas/phy/zhihe,a210-c10phy.yaml#
$schema: http://devicetree.org/meta-schemas/core.yaml#

title: ZhiHe A210 Synopsys C10 USB 3.1 PHY

maintainers:
  - Zhiguo Zhu <zhiguo.zhu@linux.alibaba.com>

description:
  The ZhiHe A210 C10 PHY provides USB3 and DisplayPort PHY ports for the
  USB 3.1 controller and DisplayPort controller.

properties:
  compatible:
    const: zhihe,a210-c10phy

  reg:
    minItems: 4
    maxItems: 4

  reg-names:
    items:
      - const: phy_ctrl
      - const: tca
      - const: sysreg
      - const: dptx_sys

  clocks:
    minItems: 1
    maxItems: 4

  resets:
    minItems: 2
    maxItems: 2

  reset-names:
    items:
      - const: phy-rst
      - const: apb-rst

  power-domains:
    maxItems: 1

  zhihe,dp-lane-mux:
    $ref: /schemas/types.yaml#/definitions/uint32-array
    minItems: 4
    maxItems: 4
    description: DisplayPort lane mux selection values.

  "#phy-cells":
    const: 0

patternProperties:
  "^(dp|u3)-port$":
    type: object
    additionalProperties: false
    properties:
      max-link-rate:
        $ref: /schemas/types.yaml#/definitions/uint32
      "#phy-cells":
        const: 0
    required:
      - "#phy-cells"

required:
  - compatible
  - reg
  - reg-names
  - clocks
  - resets
  - reset-names
  - "#phy-cells"

additionalProperties: false

examples:
  - |
    #include <dt-bindings/clock/zhihe,a210-clk.h>
    #include <dt-bindings/reset/zhihe,a210-resets.h>

    phy@8040000 {
        compatible = "zhihe,a210-c10phy";
        reg = <0x08040000 0x3c000>,
              <0x0807c000 0x2000>,
              <0x0807e000 0x100>,
              <0x08014000 0x200>;
        reg-names = "phy_ctrl", "tca", "sysreg", "dptx_sys";
        clocks = <&clk_usb C10PHY_SUSPEND_CLK_EN>,
                 <&clk_usb C10PHY_PCLK_EN>;
        resets = <&rst_usb USB_C10PHY_PHY_RST>,
                 <&rst_usb USB_C10PHY_APBS_PRST>;
        reset-names = "phy-rst", "apb-rst";
        #phy-cells = <0>;

        dp-port {
            #phy-cells = <0>;
        };

        u3-port {
            #phy-cells = <0>;
        };
    };
```

## Documentation/devicetree/bindings/phy/zhihe,a210-usb2-phy.yaml
```yaml
# SPDX-License-Identifier: (GPL-2.0-only OR BSD-2-Clause)
%YAML 1.2
---
$id: http://devicetree.org/schemas/phy/zhihe,a210-usb2-phy.yaml#
$schema: http://devicetree.org/meta-schemas/core.yaml#

title: ZhiHe A210 USB 2.0 PHY

maintainers:
  - Zhiguo Zhu <zhiguo.zhu@linux.alibaba.com>

description:
  The ZhiHe A210 contains two USB 2.0 PHYs for the DWC2 controllers, each in
  its own register block. Both are described by a single node whose PHY
  specifier selects the port index.
  The third USB 2.0 PHY is integrated with the DWC3 controller and is
  configured through a single register of the USB31 block. It is described as
  a child of the syscon owning that register, which also provides its register
  range, so the PHY node has no reg property of its own.

properties:
  compatible:
    enum:
      - zhihe,a210-dwc2-usb2-phy
      - zhihe,a210-dwc3-usb2-phy

  reg:
    minItems: 2
    maxItems: 2

  resets:
    minItems: 1
    maxItems: 2

  power-domains:
    maxItems: 1

  "#phy-cells":
    enum: [0, 1]

required:
  - compatible
  - resets
  - "#phy-cells"

additionalProperties: false

allOf:
  - if:
      properties:
        compatible:
          contains:
            const: zhihe,a210-dwc2-usb2-phy
    then:
      properties:
        reg:
          minItems: 2
          maxItems: 2
        resets:
          minItems: 2
          maxItems: 2
        "#phy-cells":
          const: 1
      required:
        - reg
    else:
      properties:
        reg: false
        resets:
          minItems: 1
          maxItems: 1
        "#phy-cells":
          const: 0

examples:
  - |
    #include <dt-bindings/reset/zhihe,a210-resets.h>

    usb-phy@8300000 {
        compatible = "zhihe,a210-dwc2-usb2-phy";
        reg = <0x08300000 0x1000>,
              <0x08301000 0x1000>;
        resets = <&rst_usb USB_USB20_BLK_USB0_PHY_PON_RESET>,
                 <&rst_usb USB_USB20_BLK_USB1_PHY_PON_RESET>;
        #phy-cells = <1>;
    };

  - |
    #include <dt-bindings/reset/zhihe,a210-resets.h>

    usb31_syscon: syscon@80000a0 {
        compatible = "zhihe,a210-usb31-syscon", "syscon", "simple-mfd";
        reg = <0x080000a0 0x4>;

        usb2-phy-dwc3 {
            compatible = "zhihe,a210-dwc3-usb2-phy";
            resets = <&rst_usb USB_USB31_PHY_RST>;
            #phy-cells = <0>;
        };
    };
```

## Documentation/devicetree/bindings/phy/zhihe,a210-usb3-phy.yaml
```yaml
# SPDX-License-Identifier: (GPL-2.0-only OR BSD-2-Clause)
%YAML 1.2
---
$id: http://devicetree.org/schemas/phy/zhihe,a210-usb3-phy.yaml#
$schema: http://devicetree.org/meta-schemas/core.yaml#

title: ZhiHe A210 USB 3.1 PHY

maintainers:
  - Zhiguo Zhu <zhiguo.zhu@linux.alibaba.com>

description:
  The ZhiHe A210 USB 3.1 PHY provides USB3 and DisplayPort PHY ports for the
  USB 3.1 controller and DisplayPort controller. When connected to a
  Type-C port controller through OF graph endpoints, the PHY also acts
  as a Type-C orientation and altmode mode switch, and notifies the
  DisplayPort host of hotplug events through an extcon device.

properties:
  compatible:
    const: zhihe,a210-usb3-phy

  reg:
    minItems: 3
    maxItems: 3

  reg-names:
    items:
      - const: phy_ctrl
      - const: tca
      - const: dptx_sys

  clocks:
    minItems: 1
    maxItems: 4

  resets:
    minItems: 2
    maxItems: 2

  reset-names:
    items:
      - const: phy-rst
      - const: apb-rst

  power-domains:
    maxItems: 1

  orientation-switch:
    description:
      Flag to indicate the PHY provides a Type-C orientation switch for
      cable flipping.

  mode-switch:
    description:
      Flag to indicate the PHY provides a Type-C altmode mode switch for
      selecting USB, DisplayPort or combined lane modes.

  svid:
    $ref: /schemas/types.yaml#/definitions/uint32
    description:
      Standard Vendor ID of the DisplayPort altmode registered through
      the Type-C mux interface.

  "#extcon-cells":
    const: 0
    description:
      The PHY exports a DisplayPort hotplug extcon device; no extra cell
      is required by consumers.

  aux-p-gpios:
    maxItems: 1
    description:
      GPIO controlling the DP AUX_P line polarity on cable flip.

  aux-n-gpios:
    maxItems: 1
    description:
      GPIO controlling the DP AUX_N line polarity on cable flip.

  port:
    $ref: /schemas/graph.yaml#/properties/port
    description:
      OF graph endpoint connecting the PHY to the Type-C connector
      controller orientation and mode switch endpoints.

  zhihe,dp-lane-mux:
    $ref: /schemas/types.yaml#/definitions/uint32-array
    minItems: 4
    maxItems: 4
    description: DisplayPort lane mux selection values.

  "#phy-cells":
    const: 0

patternProperties:
  "^(dp|u3)-port$":
    type: object
    additionalProperties: false
    properties:
      max-link-rate:
        $ref: /schemas/types.yaml#/definitions/uint32
        enum: [1620, 2700, 5400, 8100]
      "#phy-cells":
        const: 0
    required:
      - "#phy-cells"

required:
  - compatible
  - reg
  - reg-names
  - clocks
  - resets
  - reset-names
  - "#phy-cells"

additionalProperties: false

examples:
  - |
    #include <dt-bindings/clock/zhihe,a210-clk.h>
    #include <dt-bindings/reset/zhihe,a210-resets.h>

    usb-phy@8040000 {
        compatible = "zhihe,a210-usb3-phy";
        reg = <0x08040000 0x3c000>,
              <0x0807c000 0x2000>,
              <0x08014000 0x200>;
        reg-names = "phy_ctrl", "tca", "dptx_sys";
        clocks = <&clk_usb C10PHY_SUSPEND_CLK_EN>,
                 <&clk_usb C10PHY_PCLK_EN>;
        resets = <&rst_usb USB_C10PHY_PHY_RST>,
                 <&rst_usb USB_C10PHY_APBS_PRST>;
        reset-names = "phy-rst", "apb-rst";
        #phy-cells = <0>;
        orientation-switch;
        mode-switch;
        svid = <0xff01>;

        port {
            #address-cells = <1>;
            #size-cells = <0>;

            usbdp_phy0_orientation_switch: endpoint@0 {
                reg = <0>;
                remote-endpoint = <&usbc0_orien_sw>;
            };

            usbdp_phy0_dp_altmode_mux: endpoint@1 {
                reg = <1>;
                remote-endpoint = <&dp_altmode_mux>;
            };
        };

        dp-port {
            #phy-cells = <0>;
        };

        u3-port {
            #phy-cells = <0>;
        };
    };
```

## Documentation/devicetree/bindings/pinctrl/zhihe,a210-pinctrl.yaml
```yaml
# SPDX-License-Identifier: (GPL-2.0-only OR BSD-2-Clause)
%YAML 1.2
---
$id: http://devicetree.org/schemas/pinctrl/zhihe,a210-pinctrl.yaml#
$schema: http://devicetree.org/meta-schemas/core.yaml#

title: ZhiHe A210 pin controller

maintainers:
  - Zhiguo Zhu <zhiguo.zhu@linux.alibaba.com>

description: |
  Pinmux and pinconf controller of the ZhiHe A210 RISC-V SoC.

  The pads of the A210 are split into four groups, each managed by its
  own pad controller with a separate register range:

    AON pad controller     -> zhihe,a210-aon-pinctrl
    PADCTRL0 (peripheral1) -> zhihe,a210-peri1-pinctrl
    PADCTRL1 (peripheral2) -> zhihe,a210-peri2-pinctrl
    PADCTRL2 (peripheral3) -> zhihe,a210-peri3-pinctrl

  Each pad can be muxed individually to up to 8 different functions,
  though for most pads only a few of those configurations are valid.
  A few pads in the AON group do not support muxing or configuration
  at all.

  Besides muxing, each pad supports configurable drive strength,
  pull-up/pull-down bias, input enable, schmitt trigger and slew rate.

properties:
  compatible:
    enum:
      - zhihe,a210-aon-pinctrl
      - zhihe,a210-peri1-pinctrl
      - zhihe,a210-peri2-pinctrl
      - zhihe,a210-peri3-pinctrl

  reg:
    maxItems: 1

  clocks:
    maxItems: 1

  clock-names:
    const: pclk

patternProperties:
  '-[0-9]+$':
    type: object

    description:
      A pinmux group referenced by a consumer's pinctrl phandle. It
      contains one subnode per set of pads sharing the same pinmux and
      pinconf settings.

    additionalProperties: false

    patternProperties:
      '-pins$':
        type: object
        $ref: /schemas/pinctrl/pincfg-node.yaml#

        description:
          A pinctrl node describing the pinmux and pinconf settings of
          one or more pads.

        properties:
          pins:
            $ref: /schemas/pinctrl/pinmux-node.yaml#/properties/pins
            description: List of pads that properties in the node apply to.

          function:
            $ref: /schemas/pinctrl/pinmux-node.yaml#/properties/function
            enum: [ aouart, aouart_ir, aogpio0, aogpio1, aoi2c0, aoi2c1,
                    aospi, jtag, reset, por, pmic, dvs, uart0, uart1,
                    uart2, uart3, uart4, uart5, uart6, uart7, uart8,
                    uart9, uart0_ir, uart1_ir, uart2_ir, uart3_ir,
                    uart4_ir, uart5_ir, uart6_ir, uart7_ir, uart8_ir,
                    uart9_ir, gpio0, gpio1, gpio2, gpio3, gpio4, gmac0,
                    gmac1, spi0, spi1, qspi0, qspi1, pwm0, pwm1, pwm2,
                    can0, can1, can2, i2s0, i2s1, i2s2, i2s3, i2c0, i2c1,
                    i2c2, i2c3, i2c4, i2c5, i2c6, i2c7, i2c7_smb, sdio,
                    isp0, dptx, usb31, sata_p0, sata_p1, hdmi, zmac,
                    bsel, dbgm, cdbg, pdm, tdm, pcie_x1, pcie_x4,
                    sen_vclk ]
            description: The mux function to select for the given pins.

          bias-disable: true

          bias-pull-up: true

          bias-pull-down: true

          drive-strength:
            enum: [ 1, 2, 3, 5, 7, 8, 10, 12, 13, 15, 16, 18, 20, 21, 23,
                    25 ]
            description: Drive strength in mA.

          input-enable: true

          input-disable: true

          input-schmitt-enable: true

          input-schmitt-disable: true

          slew-rate:
            maximum: 1

        required:
          - pins

        additionalProperties: false

required:
  - compatible
  - reg
  - clocks
  - clock-names

additionalProperties: false

examples:
  - |
    pinctrl@2026000 {
        compatible = "zhihe,a210-peri1-pinctrl";
        reg = <0x2026000 0x1000>;
        clocks = <&clk 0>;
        clock-names = "pclk";

        gmac0-0 {
            gmac0-pins {
                pins = "GPIO0_0", "GPIO0_12";
                function = "gmac0";
                bias-disable;
                drive-strength = <13>;
                input-disable;
                input-schmitt-disable;
                slew-rate = <0>;
            };
        };
    };
```
