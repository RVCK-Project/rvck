## arch/riscv/Kconfig.errata
```kconfig
menu "CPU errata selection"

config ERRATA_ANDES
	bool "Andes AX45MP errata"
	depends on RISCV_ALTERNATIVE && RISCV_SBI
	help
	  All Andes errata Kconfig depend on this Kconfig. Disabling
	  this Kconfig will disable all Andes errata. Please say "Y"
	  here if your platform uses Andes CPU cores.

	  Otherwise, please say "N" here to avoid unnecessary overhead.

config ERRATA_ANDES_CMO
	bool "Apply Andes cache management errata"
	depends on ERRATA_ANDES && ARCH_R9A07G043
	select RISCV_DMA_NONCOHERENT
	default y
	help
	  This will apply the cache management errata to handle the
	  non-standard handling on non-coherent operations on Andes cores.

	  If you don't know what to do here, say "Y".

config ERRATA_MIPS
	bool "MIPS errata"
	depends on RISCV_ALTERNATIVE
	help
	  All MIPS errata Kconfig depend on this Kconfig. Disabling
	  this Kconfig will disable all MIPS errata. Please say "Y"
	  here if your platform uses MIPS CPU cores.

	  Otherwise, please say "N" here to avoid unnecessary overhead.

config ERRATA_MIPS_P8700_PAUSE_OPCODE
	bool "Fix the PAUSE Opcode for MIPS P8700"
	depends on ERRATA_MIPS && 64BIT
	default n
	help
	   The RISCV MIPS P8700 uses a different opcode for PAUSE.
	   It is a 'hint' encoding of the SLLI instruction,
	   with rd=0, rs1=0 and imm=5. It will behave as a NOP
	   instruction if no additional behavior beyond that of
	   SLLI is implemented.

	   If you are not using the P8700 processor, say n.

config ERRATA_SIFIVE
	bool "SiFive errata"
	depends on RISCV_ALTERNATIVE
	help
	  All SiFive errata Kconfig depend on this Kconfig. Disabling
	  this Kconfig will disable all SiFive errata. Please say "Y"
	  here if your platform uses SiFive CPU cores.

	  Otherwise, please say "N" here to avoid unnecessary overhead.

config ERRATA_SIFIVE_CIP_453
	bool "Apply SiFive errata CIP-453"
	depends on ERRATA_SIFIVE && 64BIT
	default y
	help
	  This will apply the SiFive CIP-453 errata to add sign extension
	  to the $badaddr when exception type is instruction page fault
	  and instruction access fault.

	  If you don't know what to do here, say "Y".

config ERRATA_SIFIVE_CIP_1200
	bool "Apply SiFive errata CIP-1200"
	depends on ERRATA_SIFIVE && 64BIT
	default y
	help
	  This will apply the SiFive CIP-1200 errata to repalce all
	  "sfence.vma addr" with "sfence.vma" to ensure that the addr
	  has been flushed from TLB.

	  If you don't know what to do here, say "Y".

config ERRATA_THEAD
	bool "T-HEAD errata"
	depends on RISCV_ALTERNATIVE
	help
	  All T-HEAD errata Kconfig depend on this Kconfig. Disabling
	  this Kconfig will disable all T-HEAD errata. Please say "Y"
	  here if your platform uses T-HEAD CPU cores.

	  Otherwise, please say "N" here to avoid unnecessary overhead.

config ERRATA_THEAD_PBMT
	bool "Apply T-Head memory type errata"
	depends on ERRATA_THEAD && 64BIT && MMU
	select RISCV_ALTERNATIVE_EARLY
	default y
	help
	  This will apply the memory type errata to handle the non-standard
	  memory type bits in page-table-entries on T-Head SoCs.

	  If you don't know what to do here, say "Y".

config ERRATA_THEAD_CMO
	bool "Apply T-Head cache management errata"
	depends on ERRATA_THEAD && MMU
	select DMA_DIRECT_REMAP
	select RISCV_DMA_NONCOHERENT
	default y
	help
	  This will apply the cache management errata to handle the
	  non-standard handling on non-coherent operations on T-Head SoCs.

	  If you don't know what to do here, say "Y".

config ERRATA_THEAD_PMU
	bool "Apply T-Head PMU errata"
	depends on ERRATA_THEAD && RISCV_PMU_SBI
	default y
	help
	  The T-Head C9xx cores implement a PMU overflow extension very
	  similar to the core SSCOFPMF extension.

	  This will apply the overflow errata to handle the non-standard
	  behaviour via the regular SBI PMU driver and interface.

	  If you don't know what to do here, say "Y".

endmenu # "CPU errata selection"
```

## drivers/clk/zhihe/Kconfig
```kconfig
# SPDX-License-Identifier: GPL-2.0

config CLK_ZHIHE_A210
	tristate "ZhiHe A210 clock driver"
	depends on ARCH_ZHIHE || COMPILE_TEST
	default ARCH_ZHIHE
	help
	  Build the clock controller driver for the ZhiHe A210 SoC.

	  This driver provides clock tree management including PLLs,
	  dividers, gates, and muxes for the A210 platform. Say Y if
	  you are building a kernel for the ZhiHe A210.
```

## drivers/firmware/zhihe/Kconfig
```kconfig
# SPDX-License-Identifier: GPL-2.0-only
config ZHIHE_A210_AON
	tristate "ZhiHe A210 AON protocol driver"
	depends on ZHIHE_A210_MBOX
	help
	  ZhiHe AON is a low-level system function which runs a dedicated
	  ZhiHe RISC-V E902 core to provide power, clock and resource management.

	  This driver manages the IPC interface between the host CPU and the
	  AON firmware running on the ZhiHe RISC-V E902 core.

config ZHIHE_PROC_DEBUG
	bool "ZhiHe AON debug"
	depends on ZHIHE_A210_AON
	help
	  Enable debug support for the ZhiHe AON subsystem via procfs.
	  This provides a /proc interface for reading AON firmware logs
	  and debugging the always-on subsystem.
	  Say Y here only if you need AON debugging support.
```

## drivers/phy/spacemit/Kconfig
```kconfig
# SPDX-License-Identifier: GPL-2.0-only
#
# Phy drivers for SpacemiT platforms
#
config PHY_SPACEMIT_K3_COMMON_OPS
	tristate
	select MFD_SYSCON
	select GENERIC_PHY

config PHY_SPACEMIT_K3_COMBO_PHY
	tristate "SpacemiT K3 USB3/PCIe PHY support"
	depends on (ARCH_SPACEMIT || COMPILE_TEST) && OF
	depends on COMMON_CLK
	select PHY_SPACEMIT_K3_COMMON_OPS
	help
	  Enable this to support K3 USB3/PCIe combo PHY driver. This
	  driver takes care of enabling and clock setup and will be used
	  by K3 dwc3 driver.
	  If unsure, say N.
```

## drivers/phy/zhihe/Kconfig
```kconfig
# SPDX-License-Identifier: GPL-2.0-only

config PHY_ZHIHE_A210_USB2
	tristate "ZhiHe A210 USB 2.0 PHY driver"
	depends on ARCH_ZHIHE || COMPILE_TEST
	depends on HAS_IOMEM
	depends on OF
	depends on USB_COMMON
	select GENERIC_PHY
	select MFD_SYSCON
	help
	  Enable this to support the USB 2.0 PHY instances in
	  ZhiHe A210 SoCs, including the PHY shared with the DWC3 controller.

	  To compile this driver as a module, choose M here: the module
	  will be called phy-zhihe-a210-usb2.
```

## drivers/pmdomain/Kconfig
```kconfig
# SPDX-License-Identifier: GPL-2.0-only
menu "PM Domains"

source "drivers/pmdomain/thead/Kconfig"

endmenu
```

## drivers/pmdomain/zhihe/Kconfig
```kconfig
# SPDX-License-Identifier: GPL-2.0-only

config ZHIHE_A210_POWER_DOMAIN
	tristate "ZhiHe A210 power domain driver"
	depends on PM && (ARCH_ZHIHE || COMPILE_TEST)
	select PM_GENERIC_DOMAINS
	help
	  This is the power domain driver that controls PCU/PPU for
	  the A210 SoC. It manages power gating of various hardware
	  subsystems to reduce overall power consumption.
	  Say Y here if you are building a kernel for the ZhiHe A210.
```
