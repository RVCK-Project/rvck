## Documentation/devicetree/bindings/clock/zhihe,a210-ccu.yaml
```yaml
# SPDX-License-Identifier: (GPL-2.0-only OR BSD-2-Clause)
%YAML 1.2
---
$id: http://devicetree.org/schemas/clock/zhihe,a210-ccu.yaml#
$schema: http://devicetree.org/meta-schemas/core.yaml#

title: Zhihe A210 Clock Control Unit (CCU)

maintainers:
  - Zhiguo Zhu <zhiguo.zhu@linux.alibaba.com>

description:
  The CCU (Clock Control Unit) is a hardware-level automatic clock
  management block embedded in each power domain of the Zhihe A210 SoC.
  Unlike the main clock controller (zhihe,a210-clk) which provides PLL,
  divider, gate and mux operations driven by software, the CCU
  autonomously sequences clock gating or scaling delays when its parent
  power domain transitions between power states. It does not expose
  clock outputs to consumers.

properties:
  compatible:
    const: zhihe,a210-ccu

  reg:
    minItems: 1
    maxItems: 16

  zhihe,ccu-mode:
    $ref: /schemas/types.yaml#/definitions/uint32
    default: 0
    description:
      CCU operating mode. 0 (default) selects gating mode where clocks
      are simply gated/ungated during power transitions. 1 selects
      scaling mode where clock frequencies are ramped gradually.
      Most power domains use gating mode; this property can be omitted
      in that case.

  zhihe,ccu-dly-time:
    $ref: /schemas/types.yaml#/definitions/uint32-array
    description: Per-CCU delay time value.

  zhihe,ccu-dly-time-step:
    $ref: /schemas/types.yaml#/definitions/uint32-array
    description: Per-CCU delay time step value.

  zhihe,ccu-ratio:
    $ref: /schemas/types.yaml#/definitions/uint32-array
    description: Per-CCU divider ratio (scaling mode only).

required:
  - compatible
  - reg
  - zhihe,ccu-dly-time
  - zhihe,ccu-dly-time-step

additionalProperties: false

examples:
  - |
    clock-controller@5910000 {
        compatible = "zhihe,a210-ccu";
        reg = <0x05910000 0x2c>, <0x05920000 0x2c>;
        zhihe,ccu-dly-time = <0x5e 0x5e>;
        zhihe,ccu-dly-time-step = <0x3 0x3>;
    };
```

## Documentation/devicetree/bindings/clock/zhihe,a210-clk.yaml
```yaml
# SPDX-License-Identifier: (GPL-2.0-only OR BSD-2-Clause)
%YAML 1.2
---
$id: http://devicetree.org/schemas/clock/zhihe,a210-clk.yaml#
$schema: http://devicetree.org/meta-schemas/core.yaml#

title: ZhiHe A210 Clock Controller

maintainers:
  - Zhiguo Zhu <zhiguo.zhu@linux.alibaba.com>

description:
  The ZhiHe A210 SoC contains several clock controllers spread across
  different subsystems. Each controller manages PLLs, dividers, gates and
  muxes for its subsystem. The register regions consumed by a controller
  depend on the specific compatible string.

properties:
  compatible:
    enum:
      - zhihe,a210-clk
      - zhihe,a210-peri-clk
      - zhihe,a210-gpu-clk
      - zhihe,a210-pcie-clk
      - zhihe,a210-usb-clk
      - zhihe,a210-vi-clk
      - zhihe,a210-vp-clk
      - zhihe,a210-vo-clk
      - zhihe,a210-npu-clk

  reg:
    minItems: 1
    maxItems: 9

  reg-names:
    minItems: 1
    maxItems: 9

  clocks:
    description: Input reference oscillators.
    minItems: 1
    maxItems: 3

  clock-names:
    minItems: 1
    maxItems: 3
    items:
      enum:
        - osc-32k
        - osc-24m
        - rc-24m

  "#clock-cells":
    const: 1
    description:
      The single cell is the clock ID defined in
      include/dt-bindings/clock/zhihe,a210-clk.h.

required:
  - compatible
  - reg
  - reg-names
  - "#clock-cells"

allOf:
  - if:
      properties:
        compatible:
          const: zhihe,a210-clk
    then:
      properties:
        reg:
          minItems: 9
        reg-names:
          items:
            - const: pll-wrap
            - const: top-crg
            - const: cpu-ss-clk-sysreg
            - const: cpu-ss-cpu-pll
            - const: ddr0-sysreg
            - const: ddr1-sysreg
            - const: slc-dual-sysreg
            - const: top-crg-t
            - const: cpu-ss-ccu
        clocks:
          minItems: 3
        clock-names:
          items:
            - const: osc-32k
            - const: osc-24m
            - const: rc-24m
      required:
        - clocks
        - clock-names

  - if:
      properties:
        compatible:
          const: zhihe,a210-peri-clk
    then:
      properties:
        reg:
          minItems: 5
          maxItems: 5
        reg-names:
          items:
            - const: peri0-sysreg
            - const: peri1-sysreg
            - const: peri2-sysreg
            - const: peri3-sysreg
            - const: tee-crg

  - if:
      properties:
        compatible:
          const: zhihe,a210-gpu-clk
    then:
      properties:
        reg:
          minItems: 2
          maxItems: 2
        reg-names:
          items:
            - const: gpu-ss-pwrap-clk-en
            - const: gpu-ss-top-clk-en

  - if:
      properties:
        compatible:
          const: zhihe,a210-pcie-clk
    then:
      properties:
        reg:
          maxItems: 1
        reg-names:
          items:
            - const: pcie-clk-en

  - if:
      properties:
        compatible:
          const: zhihe,a210-usb-clk
    then:
      properties:
        reg:
          maxItems: 1
        reg-names:
          items:
            - const: usb-clk-en

  - if:
      properties:
        compatible:
          const: zhihe,a210-vi-clk
    then:
      properties:
        reg:
          minItems: 2
          maxItems: 2
        reg-names:
          items:
            - const: vi-clk
            - const: vi-misc-ctrl

  - if:
      properties:
        compatible:
          const: zhihe,a210-vp-clk
    then:
      properties:
        reg:
          maxItems: 1
        reg-names:
          items:
            - const: vp-clk

  - if:
      properties:
        compatible:
          const: zhihe,a210-vo-clk
    then:
      properties:
        reg:
          minItems: 2
          maxItems: 2
        reg-names:
          items:
            - const: vo-clk
            - const: vo-path-ctrl

  - if:
      properties:
        compatible:
          const: zhihe,a210-npu-clk
    then:
      properties:
        reg:
          minItems: 2
          maxItems: 2
        reg-names:
          items:
            - const: npu-clk
            - const: npu-top-clk

additionalProperties: false

examples:
  - |
    #include <dt-bindings/clock/zhihe,a210-clk.h>

    clock-controller@260000 {
        compatible = "zhihe,a210-clk";
        reg = <0x00260000 0x1000>, <0x00250000 0x1000>,
              <0x10141600 0x100>, <0x10141400 0x100>,
              <0x04810000 0x1000>, <0x05810000 0x1000>,
              <0x04900000 0x1000>, <0x20250000 0x1000>,
              <0x10140000 0xe00>;
        reg-names = "pll-wrap", "top-crg", "cpu-ss-clk-sysreg",
                    "cpu-ss-cpu-pll", "ddr0-sysreg", "ddr1-sysreg",
                    "slc-dual-sysreg", "top-crg-t", "cpu-ss-ccu";
        clocks = <&osc_32k>, <&osc_24m>, <&rc_24m>;
        clock-names = "osc-32k", "osc-24m", "rc-24m";
        #clock-cells = <1>;
    };
```

## Documentation/devicetree/bindings/firmware/zhihe,a210-aon.yaml
```yaml
# SPDX-License-Identifier: (GPL-2.0-only OR BSD-2-Clause)
%YAML 1.2
---
$id: http://devicetree.org/schemas/firmware/zhihe,a210-aon.yaml#
$schema: http://devicetree.org/meta-schemas/core.yaml#

title: Zhihe A210 AON (Always-On) Subsystem Firmware

maintainers:
  - Zhiguo Zhu <zhiguo.zhu@linux.alibaba.com>

description:
  The Always-On (AON) subsystem of the Zhihe A210 SoC runs a dedicated
  firmware and communicates with the application processor over a
  mailbox. This node describes the AON control registers, its firmware
  image and the mailbox channel used to reach it.

properties:
  compatible:
    const: zhihe,a210-aon

  reg:
    minItems: 3
    maxItems: 3

  reg-names:
    minItems: 3
    maxItems: 3
    items:
      enum:
        - aon-base
        - aon-reset
        - aon-sync

  firmware-name:
    maxItems: 1
    description: Name of the AON firmware image to load.

  mboxes:
    maxItems: 1

  mbox-names:
    items:
      - const: aon0

  zhihe,protocol-version:
    $ref: /schemas/types.yaml#/definitions/uint32
    description: AON protocol version.

  "#mbox-cells":
    const: 2

  regulators:
    type: object
    description: Regulators controlled by the AON firmware.
    properties:
      compatible:
        const: zhihe,a210-aon-regulator
    additionalProperties: true

required:
  - compatible
  - reg
  - reg-names
  - mboxes

additionalProperties: false

examples:
  - |
    aon@308f8000 {
        compatible = "zhihe,a210-aon";
        reg = <0x308f8000 0x10000>,
              <0x30842018 0x4>,
              <0x30846144 0x4>;
        reg-names = "aon-base", "aon-reset", "aon-sync";
        firmware-name = "a210-aon.bin";
        mboxes = <&mbox_920 1 0>;
        mbox-names = "aon0";
        #mbox-cells = <2>;
        zhihe,protocol-version = <1>;
    };
```

## Documentation/devicetree/bindings/mailbox/zhihe,a210-mailbox.yaml
```yaml
# SPDX-License-Identifier: (GPL-2.0-only OR BSD-2-Clause)
%YAML 1.2
---
$id: http://devicetree.org/schemas/mailbox/zhihe,a210-mailbox.yaml#
$schema: http://devicetree.org/meta-schemas/core.yaml#

title: Zhihe A210 Mailbox Controller

maintainers:
  - Zhiguo Zhu <zhiguo.zhu@linux.alibaba.com>

description:
  Mailbox controller for the Zhihe A210 SoC provides inter-processor
  communication channels between the application processor and other
  subsystems such as the AON (Always-On) subsystem.

  The mailbox hardware interconnects up to four processors. Each
  processor has an associated ICU (Interrupt Control Unit) which owns
  one local register window of the mailbox and receives the interrupts
  the mailbox generates for that processor. The property
  "zhihe,icu-cpu-id" tells the driver which ICU, i.e. which local
  processor, this mailbox instance belongs to, so it can select its own
  local register window and map the windows of the remote processors.

properties:
  compatible:
    enum:
      - zhihe,a210-mailbox
      - zhihe,a210-mailbox-v2

  reg:
    minItems: 1
    maxItems: 8

  reg-names:
    minItems: 1
    maxItems: 8
    items:
      enum:
        - interrupt
        - local0
        - local1
        - remote0
        - remote1
        - remote2

  clocks:
    minItems: 1
    maxItems: 2

  resets:
    minItems: 1
    maxItems: 2

  interrupts:
    maxItems: 1

  zhihe,icu-cpu-id:
    $ref: /schemas/types.yaml#/definitions/uint32
    description:
      Index of the local processor's ICU (Interrupt Control Unit) this
      mailbox instance belongs to. Valid values are 0 and 3 for
      zhihe,a210-mailbox, see the description above.

  "#mbox-cells":
    const: 2

required:
  - compatible
  - reg
  - reg-names
  - interrupts
  - "#mbox-cells"

allOf:
  - if:
      properties:
        compatible:
          const: zhihe,a210-mailbox-v2
    then:
      properties:
        reg:
          minItems: 3
        reg-names:
          minItems: 3
    else:
      properties:
        reg:
          minItems: 4
        reg-names:
          minItems: 4

additionalProperties: false

examples:
  - |
    mailbox@321000 {
        compatible = "zhihe,a210-mailbox-v2";
        reg = <0x00321000 0x1000>,
              <0x00320000 0x1000>,
              <0x00311000 0x1000>;
        reg-names = "interrupt", "local0", "remote0";
        clocks = <&clk_peri 0>, <&clk_peri 1>;
        resets = <&rst 0>, <&rst 1>;
        interrupt-parent = <&intc>;
        interrupts = <336>;
        zhihe,icu-cpu-id = <0>;
        #mbox-cells = <2>;
    };
```

## Documentation/devicetree/bindings/net/zhihe,a210-dwmac.yaml
```yaml
# SPDX-License-Identifier: (GPL-2.0-only OR BSD-2-Clause)
%YAML 1.2
---
$id: http://devicetree.org/schemas/net/zhihe,a210-dwmac.yaml#
$schema: http://devicetree.org/meta-schemas/core.yaml#

title: ZhiHe A210 DWMAC Ethernet controller

maintainers:
  - Zhiguo Zhu <zhiguo.zhu@linux.alibaba.com>

description:
  The ZhiHe A210 integrates a Synopsys DesignWare MAC (dwmac-5.20) with
  an SoC-specific glue layer for clock gating, reset sequencing, interface
  selection and link-speed configuration.

select:
  properties:
    compatible:
      contains:
        const: zhihe,a210-dwmac
  required:
    - compatible

properties:
  compatible:
    items:
      - const: zhihe,a210-dwmac
      - const: snps,dwmac-5.20

  reg:
    maxItems: 1

  reg-names:
    const: gmac

  interrupts:
    maxItems: 1

  interrupt-names:
    const: macirq

  clocks:
    items:
      - description: GMAC main clock
      - description: GMAC AHB peripheral clock
      - description: X2H AXI clock
      - description: X2H AHB clock

  clock-names:
    items:
      - const: stmmaceth
      - const: pclk
      - const: x2h_aclk
      - const: x2h_hclk

  resets:
    items:
      - description: GMAC reset
      - description: X2H reset

  reset-names:
    items:
      - const: stmmaceth
      - const: ahb

  zhihe,gmacsys:
    $ref: /schemas/types.yaml#/definitions/phandle
    description:
      Phandle to the syscon node controlling GMAC interface mode and
      link speed.

  rx-clk-delay:
    $ref: /schemas/types.yaml#/definitions/uint32
    description: RGMII RX clock delay setting.

  tx-clk-delay:
    $ref: /schemas/types.yaml#/definitions/uint32
    description: RGMII TX clock delay setting.

  snps,pbl:
    $ref: /schemas/types.yaml#/definitions/uint32
    description: Programmable burst length.
    enum: [1, 2, 4, 8, 16, 32]

  snps,fixed-burst:
    type: boolean
    description: Program the DMA to use fixed burst mode.

  snps,tso:
    type: boolean
    description: Enable TCP segmentation offload.

  snps,axi-config:
    $ref: /schemas/types.yaml#/definitions/phandle
    description: Phandle to the AXI bus mode configuration node.

  mdio:
    $ref: mdio.yaml#
    unevaluatedProperties: false

    properties:
      compatible:
        const: snps,dwmac-mdio

    required:
      - compatible

required:
  - compatible
  - reg
  - clocks
  - clock-names
  - interrupts
  - interrupt-names
  - phy-mode
  - resets
  - reset-names
  - zhihe,gmacsys

allOf:
  - $ref: snps,dwmac.yaml#

unevaluatedProperties: false

examples:
  - |
    ethernet@2100000 {
        compatible = "zhihe,a210-dwmac", "snps,dwmac-5.20";
        reg = <0x02100000 0x10000>;
        reg-names = "gmac";
        interrupts = <277>;
        interrupt-names = "macirq";
        phy-mode = "rgmii-id";
        clocks = <&clk 0>, <&clk 1>, <&clk 2>, <&clk 3>;
        clock-names = "stmmaceth", "pclk", "x2h_aclk", "x2h_hclk";
        resets = <&rst 0>, <&rst 1>;
        reset-names = "stmmaceth", "ahb";
        snps,pbl = <32>;
        snps,fixed-burst;
        zhihe,gmacsys = <&gmac0_sys>;
        phy-handle = <&phy0>;

        mdio {
            compatible = "snps,dwmac-mdio";
            #address-cells = <1>;
            #size-cells = <0>;

            phy0: ethernet-phy@0 {
                reg = <0>;
            };
        };
    };
```
