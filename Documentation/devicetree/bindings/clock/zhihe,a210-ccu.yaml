## Documentation/devicetree/bindings/power/zhihe,a210-power-domain.yaml
```yaml
# SPDX-License-Identifier: (GPL-2.0-only OR BSD-2-Clause)
%YAML 1.2
---
$id: http://devicetree.org/schemas/power/zhihe,a210-power-domain.yaml#
$schema: http://devicetree.org/meta-schemas/core.yaml#

title: Zhihe A210 Power Domain Controller

maintainers:
  - Zhiguo Zhu <zhiguo.zhu@linux.alibaba.com>

description: |
  The Zhihe A210 power domain controller manages the PCU/PPU power
  sequencing for the SoC hardware blocks. Each hardware power domain is
  represented by a child node. The child node compatible string identifies
  the hardware domain and the child node itself is a generic PM domain
  provider.

  Some domains may have parent domain dependencies, clock/reset resources,
  IOPMP protection devices or CCU subnodes used for domain-local clock
  gating/scaling sequences.

properties:
  compatible:
    const: zhihe,a210-power-domain

  "#power-domain-cells":
    const: 0

  "#address-cells":
    const: 2

  "#size-cells":
    const: 2

  ranges: true

patternProperties:
  "^power-domain-[a-z0-9-]+$":
    $ref: "#/$defs/power-domain-node"
    unevaluatedProperties: false

required:
  - compatible

additionalProperties: false

$defs:
  power-domain-node:
    type: object
    description:
      A single A210 power domain. Valid compatible strings identify the
      hardware power domain controlled by this node.

    properties:
      compatible:
        enum:
          - zhihe,a210-pd-gpu
          - zhihe,a210-pd-npu-wrapper
          - zhihe,a210-pd-npu-ip
          - zhihe,a210-pd-d2d
          - zhihe,a210-pd-pcie0
          - zhihe,a210-pd-pcie1
          - zhihe,a210-pd-sata
          - zhihe,a210-pd-usb
          - zhihe,a210-pd-vi-wrap
          - zhihe,a210-pd-vi-isp
          - zhihe,a210-pd-vo
          - zhihe,a210-pd-vp-wrap
          - zhihe,a210-pd-venc
          - zhihe,a210-pd-vdec
          - zhihe,a210-pd-top
          - zhihe,a210-pd-peri0
          - zhihe,a210-pd-peri1
          - zhihe,a210-pd-peri2
          - zhihe,a210-pd-peri3
          - zhihe,a210-pd-can
          - zhihe,a210-pd-spi
          - zhihe,a210-pd-qspi
          - zhihe,a210-pd-uart
          - zhihe,a210-pd-pwm
          - zhihe,a210-pd-emmc
          - zhihe,a210-pd-sdio
          - zhihe,a210-pd-dmac

      "#power-domain-cells":
        const: 0

      "#address-cells":
        const: 2

      "#size-cells":
        const: 2

      ranges: true

      power-domains:
        maxItems: 1
        description: Parent power domain dependency.

      clocks:
        minItems: 1
        maxItems: 32

      resets:
        minItems: 1
        maxItems: 32

      iopmps:
        $ref: /schemas/types.yaml#/definitions/phandle-array
        description: IOPMP protection devices controlled with this domain.

      pmic-supply:
        description: Regulator phandle powering this domain.

    patternProperties:
      "^clock-controller@[0-9a-f]+$":
        $ref: /schemas/clock/zhihe,a210-ccu.yaml#
        unevaluatedProperties: false

    required:
      - compatible
      - "#power-domain-cells"

examples:
  - |
    a210-pds {
        compatible = "zhihe,a210-power-domain";

        power_top: power-domain-top {
            compatible = "zhihe,a210-pd-top";
            #power-domain-cells = <0>;
        };

        power_emmc: power-domain-emmc {
            compatible = "zhihe,a210-pd-emmc";
            power-domains = <&power_top>;
            #power-domain-cells = <0>;
        };
    };
```

## Documentation/devicetree/bindings/regulator/zhihe,a210-aon-regulator.yaml
```yaml
# SPDX-License-Identifier: (GPL-2.0-only OR BSD-2-Clause)
%YAML 1.2
---
$id: http://devicetree.org/schemas/regulator/zhihe,a210-aon-regulator.yaml#
$schema: http://devicetree.org/meta-schemas/core.yaml#

title: Zhihe A210 AON Regulator

maintainers:
  - Zhiguo Zhu <zhiguo.zhu@linux.alibaba.com>

description:
  Virtual regulator provider for the Zhihe A210 SoC. The regulators are
  physically controlled by the Always-On (AON) subsystem firmware and
  are accessed from the application processor over the AON mailbox.
  Each supported rail is described by a child node. The
  zhihe,regulator-id property identifies the corresponding AON firmware
  regulator ID, while regulator-name remains the standard
  consumer-visible regulator name.

properties:
  compatible:
    const: zhihe,a210-aon-regulator

patternProperties:
  "^[a-z0-9]+(-[a-z0-9]+)+$":
    type: object

    allOf:
      - $ref: regulator.yaml#

    properties:
      zhihe,regulator-id:
        $ref: /schemas/types.yaml#/definitions/uint32
        minimum: 0
        maximum: 19
        description: AON firmware regulator ID.

    required:
      - zhihe,regulator-id

    unevaluatedProperties: false

required:
  - compatible

additionalProperties: false

examples:
  - |
    regulators {
        compatible = "zhihe,a210-aon-regulator";

        dvdd-core {
            zhihe,regulator-id = <14>;
            regulator-name = "vdd-cpu";
            regulator-min-microvolt = <600000>;
            regulator-max-microvolt = <1000000>;
        };
    };
```

## Documentation/devicetree/bindings/reset/zhihe,a210-reset-sample.yaml
```yaml
# SPDX-License-Identifier: (GPL-2.0-only OR BSD-2-Clause)
%YAML 1.2
---
$id: http://devicetree.org/schemas/reset/zhihe,a210-reset-sample.yaml#
$schema: http://devicetree.org/meta-schemas/core.yaml#

title: Zhihe A210 CPU Reset (reset-sample)

maintainers:
  - Zhiguo Zhu <zhiguo.zhu@linux.alibaba.com>

description:
  CPU bring-up / reset helper for the Zhihe A210 SoC. It programs the
  per-cluster boot entry address and controls the software reset of the
  C908/C920 CPU clusters.

properties:
  compatible:
    const: zhihe,a210-reset-sample

  reg:
    maxItems: 1

  plic-delegate:
    $ref: /schemas/types.yaml#/definitions/uint32-array
    description: PLIC delegation control register address.

  entry-reg:
    $ref: /schemas/types.yaml#/definitions/uint32-array
    description: SYSREG registers used to set the per-cluster reset boot
      address.

  entry-cnt:
    $ref: /schemas/types.yaml#/definitions/uint32-array
    description: Number of CPUs in each cluster.

  control-reg:
    $ref: /schemas/types.yaml#/definitions/uint32-array
    description: Software reset control registers for each cluster.

  control-val:
    $ref: /schemas/types.yaml#/definitions/uint32-array
    description: Software reset control values for each cluster.

required:
  - compatible
  - reg
  - entry-reg
  - entry-cnt
  - control-reg
  - control-val

additionalProperties: false

examples:
  - |
    reset-sample {
        compatible = "zhihe,a210-reset-sample";
        reg = <0x00 0x00>;
        plic-delegate = <0x181ffffc>;
        entry-reg = <0x10148040 0x10148060>;
        entry-cnt = <4 4>;
        control-reg = <0x10144004 0x10144008>;
        control-val = <0x1f 0x1f>;
    };
```

## Documentation/devicetree/bindings/reset/zhihe,a210-reset.yaml
```yaml
# SPDX-License-Identifier: (GPL-2.0-only OR BSD-2-Clause)
%YAML 1.2
---
$id: http://devicetree.org/schemas/reset/zhihe,a210-reset.yaml#
$schema: http://devicetree.org/meta-schemas/core.yaml#

title: Zhihe A210 Reset Controller

maintainers:
  - Zhiguo Zhu <zhiguo.zhu@linux.alibaba.com>

description:
  Reset controllers for the Zhihe A210 SoC. Each subsystem exposes a
  separate reset controller register block and has its own compatible.

properties:
  compatible:
    enum:
      - zhihe,a210-vp-reset
      - zhihe,a210-vi-reset
      - zhihe,a210-npu-reset
      - zhihe,a210-vo-reset
      - zhihe,a210-peri0-reset
      - zhihe,a210-peri1-reset
      - zhihe,a210-peri2-reset
      - zhihe,a210-peri3-reset
      - zhihe,a210-pcie-reset
      - zhihe,a210-usb-reset
      - zhihe,a210-tee-reset
      - zhihe,a210-gpu-reset

  reg:
    maxItems: 1

  "#reset-cells":
    const: 1
    description:
      The single cell is the reset ID defined in
      include/dt-bindings/reset/zhihe,a210-resets.h.

required:
  - compatible
  - reg
  - "#reset-cells"

additionalProperties: false

examples:
  - |
    #include <dt-bindings/reset/zhihe,a210-resets.h>

    reset-controller@6b20400 {
        compatible = "zhihe,a210-vp-reset";
        reg = <0x06b20400 0x200>;
        #reset-cells = <1>;
    };
```

## Documentation/devicetree/bindings/riscv/zhihe.yaml
```yaml
# SPDX-License-Identifier: (GPL-2.0-only OR BSD-2-Clause)
%YAML 1.2
---
$id: http://devicetree.org/schemas/riscv/zhihe.yaml#
$schema: http://devicetree.org/meta-schemas/core.yaml#

title: Zhihe SoC-based boards

maintainers:
  - Zhiguo Zhu <zhiguo.zhu@linux.alibaba.com>

description:
  Zhihe SoC-based boards

properties:
  $nodename:
    const: '/'
  compatible:
    oneOf:
      - description: Zhihe A210 evaluation board
        items:
          - enum:
              - zhihe,a210-dev
              - zhihe,a210-evb
          - const: zhihe,a210

additionalProperties: true

...
```

## Documentation/devicetree/bindings/serial/lprs,zf-uart.yaml
```yaml
# SPDX-License-Identifier: GPL-2.0-only OR BSD-2-Clause

%YAML 1.2
---
$id: http://devicetree.org/schemas/serial/lprs,zf-uart.yaml#
$schema: http://devicetree.org/meta-schemas/core.yaml#

title: LeapRise ZF(ZhuFeng) serial UART

maintainers:
  - Liu Wenhong <liu.wenhong35@zte.com.cn>
  - Liu Qingtao <liu.qingtao2@zte.com.cn>

description: |
  Should be something similar to "lprs,<chip>-uart"
  for the UART as integrated on a particular chip.

properties:
  compatible:
    enum:
      - lprs,zf-uart
      - lrw,lrw-uart # deprecated, kept for backward compatibility

  reg:
    maxItems: 1

  interrupts:
    maxItems: 1

  clocks:
    maxItems: 1

required:
  - compatible
  - reg
  - current-speed
  - clocks

additionalProperties: false

examples:
  - |
    uart0: serial@e0001800 {
      compatible = "lprs,zf-uart";
      interrupt-parent = <&aplic0>;
      interrupts = <0x12 0x4>;
      reg = <0xe0001800 0x100>;
      clocks = <&bar_clk>;
      current-speed = <115200>;
    };
```

## Documentation/devicetree/bindings/soc/sophgo/sophgo.yaml
```yaml
# SPDX-License-Identifier: (GPL-2.0-only OR BSD-2-Clause)
%YAML 1.2
---
$id: http://devicetree.org/schemas/soc/sophgo/sophgo.yaml#
$schema: http://devicetree.org/meta-schemas/core.yaml#

title: Sophgo SoC-based boards

maintainers:
  - Chao Wei <chao.wei@sophgo.com>
  - Chen Wang <unicorn_wang@outlook.com>

description:
  Sophgo SoC-based boards

properties:
  $nodename:
    const: '/'
  compatible:
    oneOf:
      - items:
          - enum:
              - milkv,pioneer
              - sophgo,sg2042-evb-v1
              - sophgo,sg2042-evb-v2
          - const: sophgo,sg2042

additionalProperties: true

...
```

## Documentation/devicetree/bindings/soc/zhihe/zhihe,a210-iopmp.yaml
```yaml
# SPDX-License-Identifier: (GPL-2.0-only OR BSD-2-Clause)
%YAML 1.2
---
$id: http://devicetree.org/schemas/soc/zhihe/zhihe,a210-iopmp.yaml#
$schema: http://devicetree.org/meta-schemas/core.yaml#

title: Zhihe A210 IOPMP Controller

maintainers:
  - Zhiguo Zhu <zhiguo.zhu@linux.alibaba.com>

description:
  IO Physical Memory Protection (IOPMP) controller used on Zhihe SoCs
  to restrict peripheral DMA access to memory. Each named register
  region corresponds to an IOPMP instance guarding a particular
  subsystem.

properties:
  compatible:
    const: zhihe,a210-iopmp

  reg:
    minItems: 1
    maxItems: 16

  reg-names:
    minItems: 1
    maxItems: 16

required:
  - compatible
  - reg
  - reg-names

additionalProperties: false

examples:
  - |
    iopmp@26b12000 {
        compatible = "zhihe,a210-iopmp";
        reg = <0x26b12000 0x1000>, <0x26372000 0x1000>;
        reg-names = "vp-iopmp", "vi-iopmp";
    };
```

## Documentation/devicetree/bindings/usb/zhihe,a210-dwc3.yaml
```yaml
# SPDX-License-Identifier: (GPL-2.0-only OR BSD-2-Clause)
%YAML 1.2
---
$id: http://devicetree.org/schemas/usb/zhihe,a210-dwc3.yaml#
$schema: http://devicetree.org/meta-schemas/core.yaml#

title: ZhiHe A210 DWC3 USB controller

maintainers:
  - Zhiguo Zhu <zhiguo.zhu@linux.alibaba.com>

description:
  The ZhiHe A210 USB 3.1 wrapper provides SoC-specific clocks and resets
  around a Synopsys DesignWare USB3 controller.

properties:
  compatible:
    const: zhihe,a210-dwc3

  reg:
    maxItems: 1

  clocks:
    minItems: 2
    maxItems: 2

  clock-names:
    items:
      - const: pclk
      - const: slave-afence

  resets:
    minItems: 3
    maxItems: 3

  power-domains:
    maxItems: 1

  "#address-cells":
    const: 2

  "#size-cells":
    const: 2

  ranges: true

patternProperties:
  "^usb@[0-9a-f]+$":
    $ref: snps,dwc3.yaml#
    unevaluatedProperties: false

required:
  - compatible
  - reg
  - clocks
  - clock-names
  - resets
  - power-domains
  - "#address-cells"
  - "#size-cells"
  - ranges

additionalProperties: false

examples:
  - |
    #include <dt-bindings/clock/zhihe,a210-clk.h>
    #include <dt-bindings/reset/zhihe,a210-resets.h>

    bus {
        #address-cells = <2>;
        #size-cells = <2>;

        usb-wrapper@8100000 {
            compatible = "zhihe,a210-dwc3";
            reg = <0x00 0x08100000 0x0 0x100000>;
            clocks = <&clk_usb USB31_PCLK_EN>,
                     <&clk_usb USB31_SLV_AFENCE_ACLK_EN>;
            clock-names = "pclk", "slave-afence";
            resets = <&rst_usb USB_USB31_SLV_AFENCE_ARST>,
                     <&rst_usb USB_USB31_VCC_RST>,
                     <&rst_usb USB_USB31_APBS_PRST>;
            power-domains = <&power_usb>;
            #address-cells = <2>;
            #size-cells = <2>;
            ranges = <0x00 0x00 0x00 0x08100000 0x00 0x100000>;

            usb@0 {
                compatible = "snps,dwc3";
                reg = <0x00 0x00 0x00 0x100000>;
                interrupts = <183>;
                clocks = <&clk_usb USB31_REF_CLK_EN>,
                         <&clk_usb USB31_BUS_CLK_EN>,
                         <&clk_usb USB31_SUSPEND_CLK_EN>;
                clock-names = "ref", "bus_early", "suspend";
                dr_mode = "host";
            };
        };
    };
...
```
