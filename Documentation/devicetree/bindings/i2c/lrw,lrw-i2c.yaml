## Documentation/devicetree/bindings/i2c/lrw,lrw-i2c.yaml
```yaml
# SPDX-License-Identifier: GPL-2.0-only OR BSD-2-Clause

%YAML 1.2
---
$id: http://devicetree.org/schemas/i2c/lrw-i2c.yaml#
$schema: http://devicetree.org/meta-schemas/core.yaml#

title: LRW I2C

maintainers:
  - Fei Liu <liu.fei16@zte.com.cn>
  - Xiaowei Han <han.xiaowei1@zte.com.cn>
  - Qingtao Liu <liu.qingtao2@zte.com.cn>

description: |
  Should be something similar to "lrw,<chip>-i2c"
  for the I2C as integrated on a particular chip, It supports
  multiple CPU architectures, currently including e.g. RISC-V and ARM.

properties:
  compatible:
    const: lrw,sc-i2c

  reg:
    maxItems: 1

  interrupts:
    maxItems: 1

  clocks:
    maxItems: 1

  clock-frequency:
    description: |
    frequency of the bus clock in Hz defaults to 100 kHz when not specified

  fs_hcnt:
    description: |
      High-level duration count in Standard/Fast Mode (100kHz / 400kHz / 1MHz)
      Represents the number of clock cycles (clk cycles) that the signal remains at high level
      during Standard or Fast Mode communication

  fs_lcnt:
    description: |
      Low-level duration count in Standard/Fast Mode (100kHz / 400kHz / 1MHz)
      Represents the number of clock cycles (clk cycles) that the signal remains at low level
      during Standard or Fast Mode communication

  hs_hcnt:
    description: |
      High-level duration count in High-Speed Mode (>1MHz).
      Represents the number of clock cycles (clk cycles) that the signal remains at high level
      during High-Speed Mode communication (baud rate greater than 1MHz)

  hs_lcnt:
    description: |
      Low-level duration count in High-Speed Mode (>1MHz).
      Represents the number of clock cycles (clk cycles) that the signal remains at low level
      during High-Speed Mode communication (baud rate greater than 1MHz)

  sda_hold_time:
    description: |
      Hold time configuration for SDA signal, in clock cycles (clk cycles)
      The value is a 32-bit integer with bitfield division:
      - Bits [23:16]: Hold time in RX mode (SDA signal hold duration when receiving data)
      - Bits [15:0]: Hold time in TX mode (SDA signal hold duration when transmitting data)

  sda_stuck_at_low_timeout:
    description: |
      Timeout threshold when SDA signal is stuck at low level, in clock cycles (clk cycles).
      When the SDA signal remains low for a duration exceeding this count, the I2C controller
      will trigger the bus recovery mechanism to restore normal communication

required:
  - compatible
  - interrupts
  - reg
  - clock-frequency
  - clocks

additionalProperties: false

examples:
  - |
    i2c@825e822000 {
      compatible = "lrw,sc-i2c";
      interrupt-parent = <&iod1_socbar_s0_aplic>;
      interrupts = <0x77 0x4>;
      reg = <0x82 0x08121000 0x00 0x1000>;
      clocks = <&sc_i2c_clk>;
      clock-frequency = <100000>;
      fs_hcnt = <0x1ef>;
      fs_lcnt = <0x1f4>;
      hs_hcnt = <0x2d>;
      hs_lcnt = <0x33>;
      sda_hold_time = <0x10008>;
      sda_stuck_at_low_timeout = <0x262599>;
    };
```

## Documentation/devicetree/bindings/serial/lrw,lrw-uart.yaml
```yaml
# SPDX-License-Identifier: GPL-2.0-only OR BSD-2-Clause

%YAML 1.2
---
$id: http://devicetree.org/schemas/serial/lrw-uart.yaml#
$schema: http://devicetree.org/meta-schemas/core.yaml#

title: LRW serial UART

maintainers:
  - Wenhong Liu <liu.wenhong35@zte.com.cn>
  - Qingtao Liu <liu.qingtao2@zte.com.cn>

description: |
  Should be something similar to "lrw,<chip>-uart"
  for the UART as integrated on a particular chip, It supports
  multiple CPU architectures, currently including e.g. RISC-V and ARM.

properties:
  compatible:
    const: lrw,lrw-uart

  reg:
    maxItems: 1

  interrupts:
    maxItems: 1

  clocks:
    maxItems: 1

required:
  - compatible
  - reg
  - current-speed
  - clocks

additionalProperties: false

examples:
  - |
    uart0: serial@e0001800 {
      compatible = "lrw,lrw-uart";
      interrupt-parent = <&aplic0>;
      interrupts = <0x12 0x4>;
      reg = <0xe0001800 0x100>;
      clocks = <&bar_clk>;
      current-speed = <115200>;
    };
```

## arch/riscv/configs/k1_defconfig
```kconfig
#
# Spacemit k1 SoC support
#
CONFIG_SOC_SPACEMIT=y
CONFIG_SOC_SPACEMIT_K1=y
CONFIG_SOC_SPACEMIT_K1X=y
CONFIG_SPACEMIT_K1X_CCU=y
CONFIG_RESET_K1X_SPACEMIT=y
CONFIG_PINCTRL_SPACEMIT_K1X=y
CONFIG_GPIO_K1X=y
CONFIG_SERIAL_SPACEMIT_K1X=y
CONFIG_SERIAL_SPACEMIT_K1X_CONSOLE=y
CONFIG_SERIAL_DEV_BUS=y
CONFIG_SPACEMIT_MEM_RANGE=y
CONFIG_SPACEMIT_K1_DMA=y
CONFIG_I2C_SPACEMIT_K1=y
CONFIG_SPI_SPACEMIT_K1=y
```

## arch/riscv/configs/k3_defconfig
```kconfig
#
# Spacemit k3 SoC support
#
CONFIG_SOC_SPACEMIT=y
CONFIG_SOC_SPACEMIT_K3=y
CONFIG_RISCV_ISA_ZICBOM=y
CONFIG_SPACEMIT_CCU=y
CONFIG_SPACEMIT_K3_CCU=y
CONFIG_RESET_SPACEMIT=y
CONFIG_RESET_SPACEMIT_K3=y

CONFIG_PINCTRL_SPACEMIT_K3=y
CONFIG_GPIO_SPACEMIT_K3=y
CONFIG_I2C_SPACEMIT_K1=y
CONFIG_MFD_CORE=y
CONFIG_MFD_SPACEMIT_P1=y
CONFIG_REGULATOR_SPACEMIT_P1=y
CONFIG_REGULATOR_FIXED_VOLTAGE=y
CONFIG_INPUT_SPACEMIT_P1_PWRKEY=m
CONFIG_PINCTRL_SPACEMIT_P1=m
CONFIG_RTC_DRV_SPACEMIT_P1=m
CONFIG_SPACEMIT_P1_ADC=m

CONFIG_DWMAC_SPACEMIT_ETHQOS=m
CONFIG_MMC_SDHCI_OF_K1=y
```

## arch/riscv/configs/sg2042_defconfig
```kconfig
#
# sg2042_defconfig
#
CONFIG_ARCH_SOPHGO=y
CONFIG_MMC_SDHCI_SOPHGO=y
CONFIG_PCIE_CADENCE_SOPHGO=y
CONFIG_RISCV_ISA_V=n
CONFIG_RISCV_ISA_ZICBOM=n
CONFIG_HIGHMEM=y
CONFIG_SPARSEMEM_VMEMMAP=n
CONFIG_SPI_SOPHGO_SPIFMC=m
CONFIG_DEBUG_VM=n
CONFIG_I2C=y
CONFIG_BLK_DEV_NVME=y
CONFIG_MTD=m
CONFIG_MTD_SPI_NOR=m
CONFIG_SPI_SOPHGO_SPIFMC=m
# end of sg2042_defconfig
```

## drivers/clk/spacemit/Kconfig
```kconfig
# SPDX-License-Identifier: GPL-2.0
# common clock support for SPACEMIT SoC family.

config SPACEMIT_K1_CCU
        tristate "Clock support for Spacemit k1 SoC"
        depends on SOC_SPACEMIT_K1
        help
          Build the driver for Spacemit K1 Clock Driver.
```

## drivers/net/ethernet/spacemit/Kconfig
```kconfig
config NET_VENDOR_SPACEMIT
	bool "Spacemit devices"
	default y
	depends on SOC_SPACEMIT
	help
	  If you have a network (Ethernet) chipset belonging to this class,
	  say Y.

	  Note that the answer to this question does not directly affect
	  the kernel: saying N will just cause the configurator to skip all
	  the questions regarding Spacemit chipsets. If you say Y, you will
	  be asked for your specific chipset/driver in the following questions.

if NET_VENDOR_SPACEMIT

config K1_EMAC
	tristate "k1 Emac Driver"
	depends on SOC_SPACEMIT_K1
	select PHYLIB
	help
	  This Driver support Spacemit k1 Ethernet MAC
	  Say Y to enable support for the Spacemit Ethernet.

endif # NET_VENDOR_SPACEMIT
```

## drivers/pinctrl/ultrarisc/Kconfig
```kconfig
# SPDX-License-Identifier: GPL-2.0-only

config PINCTRL_ULTRARISC
	bool
	depends on OF
	select PINMUX
	select GENERIC_PINCTRL_GROUPS
	select GENERIC_PINCONF
	select GENERIC_PINMUX_FUNCTIONS
	select GPIOLIB
	select IRQ_DOMAIN_HIERARCHY
	select MFD_SYSCON

config PINCTRL_ULTRARISC_DP1000
	tristate "Pinctrl driver of UltraRISC DP1000"
	select PINCTRL_ULTRARISC
	depends on OF && HAS_IOMEM
	help
	  This driver configures the UltraRISC DP1000 SoC's pinctrl subsystem.

	  This option is only visible when device-tree support (`OF`) is enabled
	  and physical memory-mapped I/O regions are available (`HAS_IOMEM`),
	  and it automatically selects the core `Pinctrl ULTRARISC` driver.
```

## drivers/reset/spacemit/Kconfig
```kconfig
# SPDX-License-Identifier: GPL-2.0-only

config RESET_SPACEMIT
	tristate "SpacemiT reset driver"
	depends on SOC_SPACEMIT || COMPILE_TEST
	select AUXILIARY_BUS
	default SOC_SPACEMIT
	help
	  This enables the reset controller driver for SpacemiT SoCs.

config RESET_SPACEMIT_K1
	tristate "SpacemiT k1 reset driver"
	depends on RESET_SPACEMIT || COMPILE_TEST
	default SOC_SPACEMIT_K1
	help
	  This enables the reset controller driver for SpacemiT k1.

config RESET_SPACEMIT_K3
	tristate "SpacemiT k3 reset driver"
	depends on RESET_SPACEMIT || COMPILE_TEST
	default SOC_SPACEMIT_K3
	help
	  This enables the reset controller driver for SpacemiT k3.
```

## drivers/soc/spacemit/Kconfig
```kconfig
# SPDX-License-Identifier: GPL-2.0-only

menu "Spacemit SoC drivers"
	depends on SOC_SPACEMIT

config SPACEMIT_MEM_RANGE
	bool "add memory range support for DMA device's."
	help
	  This driver add memory range process for the devices whose address
	  space access is restricted, such as not full memory area supportted,
	  or address space is not same as cpu's.

endmenu
```
