## Documentation/devicetree/bindings/riscv/ntrace/xuantie,ntrace-sink.yaml
```yaml
# SPDX-License-Identifier: GPL-2.0-only OR BSD-2-Clause
%YAML 1.2
---
$id: http://devicetree.org/schemas/riscv/ntrace/xuantie,ntrace-sink.yaml#
$schema: http://devicetree.org/meta-schemas/core.yaml#

title: RISC-V XUANTIE N-Trace sink controller

maintainers:
  - Jiangshuai Li <jiangshuai_li@linux.alibaba.com>
  - Chen Pei <cp0613@linux.alibaba.com>

description: |
  The sink collects the merged trace stream and writes it either into a
  reserved memory region (memory-region) or into a DMA coherent buffer
  allocated by the driver (iommu-trace-buffer-size). The perf auxtrace
  back-end reads the buffer through the sink registers given in reg.

  Sink registers are accessed through the memory region given in reg.

properties:
  compatible:
    const: xuantie,ntrace-sink

  reg:
    maxItems: 1
    description:
      Sink register region.

  iommus:
    maxItems: 1
    description:
      IOMMU group for DMA buffer access. Optional; when absent the driver
      uses physical addresses directly (requires the sink to be bus-master
      capable without translation).

  working_mode:
    $ref: /schemas/types.yaml#/definitions/string
    description:
      Sink operating mode as reported by the driver at probe time. The driver
      only records and prints this string, defaulting to
      "circulating buffer", which is the only mode the hardware currently
      supports.

  format:
    $ref: /schemas/types.yaml#/definitions/string
    description:
      Data format stored in the trace buffer. The driver only records and
      prints this string, defaulting to "original" (raw N-Trace message
      stream).

  memory-region:
    $ref: /schemas/types.yaml#/definitions/phandle
    description:
      Phandle of a reserved-memory node holding the trace buffer. When
      absent, the driver allocates a DMA coherent buffer instead.

  iommu-trace-buffer-size:
    $ref: /schemas/types.yaml#/definitions/uint32
    description:
      Size in bytes of the DMA coherent trace buffer. Only read when
      memory-region is absent; a value of 0 selects the driver default.

  input_port:
    type: object
    description:
      Container of the sink input ports. Each child node describes one port
      and must carry an "endpoint" phandle pointing at the upstream funnel
      node. The phandle identifies that node; the port needs no address cells,
      because the driver resolves the peer through the node itself.

    patternProperties:
      ".*":
        type: object
        properties:
          endpoint:
            $ref: /schemas/types.yaml#/definitions/phandle
        required:
          - endpoint
        additionalProperties: false

  '#address-cells':
    const: 1

  '#size-cells':
    const: 0

required:
  - compatible
  - reg
  - input_port

additionalProperties: false

example:
  - |
    sink0: sink@2020002000 {
        compatible = "xuantie,ntrace-sink";
        reg = <0x20 0x20002000 0x0 0x1000>;
        working_mode = "circulating buffer";
        format = "original";
        memory-region = <&ntrace_reserved>;
        #address-cells = <1>;
        #size-cells = <0>;

        input_port {
            sink0_in_0 {
                endpoint = <&funnel1>;
            };
        };
    };

...
```

## drivers/hwtracing/xuantie_ntrace/Kconfig
```kconfig
# SPDX-License-Identifier: GPL-2.0
config XUANTIE_NTRACE
	tristate "XUANTIE NTRACE events"
	depends on PERF_EVENTS && RISCV && SMP
	depends on OF || ACPI
	help
	  xuantie_ntrace is an instruction-level trace component
	  of the CPU. xuantie_ntrace system uses RISC-V Nexus
	  Trace solution.  Implement a xuantie_ntrace pmu driver
	  and integrate the trace function into the perf framework
	  so that the trace function can be used through the perf
	  command.  The trace topology is described either by the
	  device tree or, on ACPI systems, by the RISC-V trace
	  devices and their _DSD device graph.
```
