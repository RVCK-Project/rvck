## Documentation/devicetree/bindings/perf/xuange,cpm-pmu.yaml
```yaml
# SPDX-License-Identifier: (GPL-2.0-only OR BSD-2-Clause)
%YAML 1.2
---
$id: http://devicetree.org/schemas/perf/xuange,cpm-pmu.yaml#
$schema: http://devicetree.org/meta-schemas/core.yaml#

title: Xuange v1 CHI performance monitor

maintainers:
  - Dong Yan <yandong@linux.alibaba.com>

description: |
  CPM provides eight CHI transaction/latency counter slots and OSTD/LCRD
  flow-control statistics. CPU subsystem instances have an additional
  selector register; DDR subsystem instances do not. Control registers
  must not be reconfigured while monitoring is enabled.

properties:
  compatible:
    const: xuange,cpm-pmu-v1

  reg:
    minItems: 1
    items:
      - description: CPM monitoring registers
      - description: Optional CPU subsystem CPM selector register

  interrupts:
    maxItems: 1

  numa-node-id:
    description: NUMA node containing this CPM instance.

  xuange,cpm-name:
    $ref: /schemas/types.yaml#/definitions/string
    pattern: '^[a-zA-Z0-9_]+$'
    description: |
      Unique instance suffix for the cpm_ perf PMU name, such as
      die0_complex8 or die0_ddr2a. If omitted, the driver derives the
      name from the register address.

  xuange,fpga:
    type: boolean
    description: |
      This instance uses the 7.6 MHz HAPS CPM input clock. The driver uses
      a monitoring-period exponent of 16. When absent, the instance uses
      the 1.9 GHz silicon clock and an exponent of 24.

required:
  - compatible
  - reg
  - interrupts

additionalProperties: false

examples:
  - |
    soc {
        #address-cells = <2>;
        #size-cells = <2>;

        pmu@192120000 {
            compatible = "xuange,cpm-pmu-v1";
            reg = <0x1 0x92120000 0x0 0x230>,
                  <0x1 0x92121034 0x0 0x4>;
            interrupt-parent = <&aplic>;
            interrupts = <5 4>;
            numa-node-id = <0>;
            xuange,cpm-name = "die0_complex8";
            xuange,fpga;
        };
    };
```

## Documentation/devicetree/bindings/perf/xuange,ddr-pmu.yaml
```yaml
# SPDX-License-Identifier: (GPL-2.0-only OR BSD-2-Clause)
%YAML 1.2
---
$id: http://devicetree.org/schemas/perf/xuange,ddr-pmu.yaml#
$schema: http://devicetree.org/meta-schemas/core.yaml#

title: Xuange DDR performance monitor

maintainers:
  - Dong Yan <yandong@linux.alibaba.com>

description: |
  Each Xuange DDR controller PMU provides 16 ordinary 64-bit counters
  and 16 debug slots. Each debug slot records a pair of 16-bit minimum
  and maximum values with a shared enable bit. The register block includes
  mode control at 0x00, duration at 0x04/0x08, enables at 0x0c, function
  selection at 0x10 and software reset at 0x1c. Ordinary counters occupy
  0x30-0xaf and debug results occupy 0xb0-0xef. The platform maps a 0x2000
  byte resource for each controller; it must cover these registers.

  Event IDs 0x00-0x3f select an ordinary counter with ID / 4 and its
  function with ID modulo 4, excluding reserved functions. Debug IDs
  0x40-0x7d use the same slot encoding and select min/max with bit 0;
  function values 2 and 3 are reserved. Event names are exported by perf
  sysfs and are not configured in the device tree.

properties:
  compatible:
    const: xuange,ddr-pmu-v1

  reg:
    maxItems: 1

  interrupts:
    maxItems: 1
    description: Optional hardware interrupt, unused in software-stop mode.

  numa-node-id:
    description: NUMA node local to this DDR controller.

required:
  - compatible
  - reg

additionalProperties: false

examples:
  - |
    soc {
        #address-cells = <2>;
        #size-cells = <2>;

        pmu@593400000 {
            compatible = "xuange,ddr-pmu-v1";
            reg = <0x5 0x93400000 0x0 0x2000>;
        };
    };
```

## Documentation/devicetree/bindings/phy/zhihe,a210-usb2-phy.yaml
```yaml
# SPDX-License-Identifier: (GPL-2.0-only OR BSD-2-Clause)
%YAML 1.2
---
$id: http://devicetree.org/schemas/phy/zhihe,a210-usb2-phy.yaml#
$schema: http://devicetree.org/meta-schemas/core.yaml#

title: ZhiHe A210 USB 2.0 PHY

maintainers:
  - Zhiguo Zhu <zhiguo.zhu@linux.alibaba.com>

description:
  The ZhiHe A210 contains two USB 2.0 PHYs for the DWC2 controllers, each
  described by a separate node with its own register block and reset.
  The third USB 2.0 PHY is integrated with the DWC3 controller and is
  configured through a register in the shared USB system register block, so
  its node has no reg property of its own.

properties:
  compatible:
    enum:
      - zhihe,a210-dwc2-usb2-phy
      - zhihe,a210-dwc3-usb2-phy

  reg:
    maxItems: 1

  resets:
    maxItems: 1

  power-domains:
    maxItems: 1

  zhihe,pulldown-mask:
    $ref: /schemas/types.yaml#/definitions/uint32
    maximum: 0xf
    description:
      Bit mask selecting the D+ and D- pulldown controls for this PHY.

  zhihe,usb-syscon:
    $ref: /schemas/types.yaml#/definitions/phandle
    description:
      Phandle to the USB clock controller and shared system register block.

  "#phy-cells":
    const: 0

required:
  - compatible
  - resets
  - "#phy-cells"

additionalProperties: false

allOf:
  - if:
      properties:
        compatible:
          contains:
            const: zhihe,a210-dwc2-usb2-phy
    then:
      properties:
        zhihe,usb-syscon: false
      required:
        - reg
        - zhihe,pulldown-mask
    else:
      properties:
        reg: false
        zhihe,pulldown-mask: false
      required:
        - zhihe,usb-syscon

examples:
  - |
    #include <dt-bindings/reset/zhihe,a210-resets.h>

    usb2_phy0: usb-phy@8300000 {
        compatible = "zhihe,a210-dwc2-usb2-phy";
        reg = <0x08300000 0x1000>;
        resets = <&rst_usb USB_USB20_BLK_USB0_PHY_PON_RESET>;
        zhihe,pulldown-mask = <0x3>;
        #phy-cells = <0>;
    };

  - |
    #include <dt-bindings/reset/zhihe,a210-resets.h>

    usb2-phy {
        compatible = "zhihe,a210-dwc3-usb2-phy";
        zhihe,usb-syscon = <&clk_usb>;
        resets = <&rst_usb USB_USB31_PHY_RST>;
        #phy-cells = <0>;
    };
```

## Documentation/devicetree/bindings/riscv/ntrace/xuantie,ntrace-encoder.yaml
```yaml
# SPDX-License-Identifier: GPL-2.0-only OR BSD-2-Clause
%YAML 1.2
---
$id: http://devicetree.org/schemas/riscv/ntrace/xuantie,ntrace-encoder.yaml#
$schema: http://devicetree.org/meta-schemas/core.yaml#

title: RISC-V XUANTIE N-Trace encoder controller

maintainers:
  - Jiangshuai Li <jiangshuai_li@linux.alibaba.com>
  - Chen Pei <cp0613@linux.alibaba.com>

description: |
  One node describes the instruction trace encoder of a single hart. The
  encoder packs the executed-branch trace stream into N-Trace messages and
  pushes them to the downstream component listed in its output_port.

  Encoder registers are accessed through the memory region given in reg.

properties:
  compatible:
    const: xuantie,ntrace-encoder

  reg:
    maxItems: 1
    description:
      Encoder register region.

  cpu:
    $ref: /schemas/types.yaml#/definitions/uint32
    description:
      Linux CPU number this encoder belongs to. The driver derives the hart
      id from it, so the property is mandatory.

  trace_encoder_format:
    $ref: /schemas/types.yaml#/definitions/uint32
    minimum: 0
    maximum: 7
    default: 1
    description:
      Trace encoding format. 1 selects N-Trace, 0 ARM E-trace style encoding,
      7 vendor defined. Only N-Trace is decoded by the perf tool.

  trace_encoder_inst_mode:
    $ref: /schemas/types.yaml#/definitions/uint32
    minimum: 0
    maximum: 7
    default: 6
    description:
      Instruction tracing level. 3 selects branch trace, 6 branch history
      trace, 0 disables instruction trace, 7 vendor defined.

  trace_encoder_context:
    $ref: /schemas/types.yaml#/definitions/string
    enum: ["true", "false"]
    default: "true"
    description:
      Send context (privilege mode changes) messages. The driver compares the
      string against "true".

  trace_encoder_inst_stall_enable:
    $ref: /schemas/types.yaml#/definitions/string
    enum: ["true", "false"]
    default: "true"
    description:
      Emit stall messages when the hart stops retiring instructions.

  trace_encoder_inhibit_src:
    $ref: /schemas/types.yaml#/definitions/string
    enum: ["true", "false"]
    default: "false"
    description:
      Suppress the source identifier in the trace stream. When "false" the
      src id is emitted.

  trace_encoder_src_id:
    $ref: /schemas/types.yaml#/definitions/uint32
    description:
      Source identifier written into the trace stream. Defaults to the value
      of cpu.

  trace_encoder_inst_sync_mode:
    $ref: /schemas/types.yaml#/definitions/uint32
    enum: [0, 1, 2, 3]
    default: 0
    description:
      Periodic synchronisation mode. 0 no sync packets, 1 counted trace
      messages, 2 counted hart clock cycles, 3 counted 16-bit half-words.

  trace_encoder_inst_sync_max:
    $ref: /schemas/types.yaml#/definitions/uint32
    description:
      Period of the sync packets selected by trace_encoder_inst_sync_mode.
      Mandatory (probe fails) whenever trace_encoder_inst_sync_mode is not 0.

  trace_encoder_inst_trigger_enable:
    $ref: /schemas/types.yaml#/definitions/string
    enum: ["true", "false"]
    default: "true"
    description:
      Allow the encoder to be enabled and disabled by a hardware trigger.

  trace_timestamp_enable:
    $ref: /schemas/types.yaml#/definitions/string
    enum: ["true", "false"]
    default: "false"
    description:
      Emit timestamp messages.

  trace_timestamp_mode:
    $ref: /schemas/types.yaml#/definitions/uint32
    minimum: 0
    maximum: 7
    description:
      Timestamp source. 0 none, 1 external signal, 2 internal system counter,
      3 internal core counter, 4 shared counter, 7 vendor specific. Mandatory
      (probe fails) whenever trace_timestamp_enable is "true".

  trace_timestamp_prescale:
    $ref: /schemas/types.yaml#/definitions/uint32
    default: 0
    description:
      Prescaler applied to the timestamp counter before it is encoded.

  output_port:
    type: object
    description:
      Container of the encoder output ports. Each child node describes one
      port and must carry an "endpoint" phandle pointing at the downstream
      funnel or sink node. The phandle identifies that node; the port needs no
      address cells, because the driver resolves the peer through the node
      itself.

    patternProperties:
      ".*":
        type: object
        properties:
          endpoint:
            $ref: /schemas/types.yaml#/definitions/phandle
        required:
          - endpoint
        additionalProperties: false

  '#address-cells':
    const: 1

  '#size-cells':
    const: 0

required:
  - compatible
  - reg
  - cpu
  - output_port

additionalProperties: false

example:
  - |
    encoder0: encoder@2020000000 {
        compatible = "xuantie,ntrace-encoder";
        reg = <0x20 0x20000000 0x0 0x1000>;
        cpu = <0>;
        trace_encoder_format = <1>;
        trace_encoder_inst_mode = <6>;
        trace_encoder_context = "true";
        trace_encoder_inst_stall_enable = "true";
        trace_encoder_inhibit_src = "false";
        trace_encoder_src_id = <0>;
        trace_encoder_inst_sync_mode = <0>;
        trace_encoder_inst_trigger_enable = "true";
        trace_timestamp_enable = "true";
        trace_timestamp_mode = <2>;
        trace_timestamp_prescale = <0>;
        #address-cells = <1>;
        #size-cells = <0>;

        output_port {
            encoder_0_1 {
                endpoint = <&funnel1>;
            };
        };
    };

...
```

## Documentation/devicetree/bindings/riscv/ntrace/xuantie,ntrace-funnel.yaml
```yaml
# SPDX-License-Identifier: GPL-2.0-only OR BSD-2-Clause
%YAML 1.2
---
$id: http://devicetree.org/schemas/riscv/ntrace/xuantie,ntrace-funnel.yaml#
$schema: http://devicetree.org/meta-schemas/core.yaml#

title: RISC-V XUANTIE N-Trace funnel controller

maintainers:
  - Jiangshuai Li <jiangshuai_li@linux.alibaba.com>
  - Chen Pei <cp0613@linux.alibaba.com>

description: |
  The funnel merges the trace streams of several upstream components into one
  downstream component. Each input port is enabled individually, so the
  encoder and funnel nodes feeding this funnel must list it in their
  output_port.

  Funnel registers are accessed through the memory region given in reg.

properties:
  compatible:
    const: xuantie,ntrace-funnel

  reg:
    maxItems: 1
    description:
      Funnel register region.

  level:
    $ref: /schemas/types.yaml#/definitions/uint32
    enum: [1, 2]
    default: 1
    description:
      Funnel depth in the trace tree. Level 1 collects encoder streams, level
      2 collects level 1 funnel streams.

  input_port:
    type: object
    description:
      Container of the funnel input ports. Each child node describes one port
      and must carry an "endpoint" phandle pointing at the upstream component
      node. The phandle identifies that node; the port needs no address cells,
      because the driver resolves the peer through the node itself.

    patternProperties:
      ".*":
        type: object
        properties:
          endpoint:
            $ref: /schemas/types.yaml#/definitions/phandle
        required:
          - endpoint
        additionalProperties: false

  output_port:
    type: object
    description:
      Container of the funnel output ports, using the same port description as
      input_port.

    patternProperties:
      ".*":
        type: object
        properties:
          endpoint:
            $ref: /schemas/types.yaml#/definitions/phandle
        required:
          - endpoint
        additionalProperties: false

  '#address-cells':
    const: 1

  '#size-cells':
    const: 0

required:
  - compatible
  - reg
  - input_port
  - output_port

additionalProperties: false

example:
  - |
    funnel1: funnel@2020001000 {
        compatible = "xuantie,ntrace-funnel";
        reg = <0x20 0x20001000 0x0 0x1000>;
        level = <1>;
        #address-cells = <1>;
        #size-cells = <0>;

        input_port {
            funnel1_in_0 {
                endpoint = <&encoder0>;
            };
            funnel1_in_1 {
                endpoint = <&encoder1>;
            };
        };

        output_port {
            funnel1_out_0 {
                endpoint = <&sink0>;
            };
        };
    };

...
```
