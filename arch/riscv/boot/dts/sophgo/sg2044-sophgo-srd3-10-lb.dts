// SPDX-License-Identifier: (GPL-2.0 OR MIT)
/*
 * Copyright (C) 2026 Han Gao <gaohan@iscas.ac.cn>
 */

/dts-v1/;

#include "sg2044-sophgo-srd3-10.dts"

/ {
	model = "Sophgo SG2044 SRD3-10-LB";
	compatible = "sophgo,srd3-10-lb", "sophgo,srd3-10",
		     "sophgo,sg2044";
};

&pcie0 {
	status = "disabled";
};

&pcie1 {
	reg = <0x6c 0x00400000 0x0 0x00001000>,
	      <0x6c 0x00700000 0x0 0x00004000>,
	      <0x00 0x40000000 0x0 0x00001000>,
	      <0x6c 0x00780000 0x0 0x00001000>;
	ranges = <0x01000000 0x00 0x00000000 0x00 0x50000000 0x00 0x00100000>,
		 <0x02000000 0x00 0x58000000 0x00 0x58000000 0x00 0x08000000>,
		 <0x43000000 0x40 0x00000000 0x40 0x00000000 0x20 0x00000000>;
};
